## configs/pyxis-minimal_defconfig
```kconfig
CONFIG_ARM=y
CONFIG_SKIP_LOWLEVEL_INIT=y
CONFIG_POSITION_INDEPENDENT=y
CONFIG_SYS_INIT_SP_BSS_OFFSET=0x180000
CONFIG_ARCH_SNAPDRAGON=y
CONFIG_NR_DRAM_BANKS=24
CONFIG_DEFAULT_DEVICE_TREE="qcom/sdm710-xiaomi-pyxis"
CONFIG_SYS_LOAD_ADDR=0xA0000000
# CONFIG_EFI_LOADER is not set
CONFIG_BUTTON_CMD=y
CONFIG_FIT=y
CONFIG_BOOTSTD_FULL=y
# CONFIG_BOOTMETH_VBE is not set
CONFIG_BOOTDELAY=1
CONFIG_BOOT_RETRY=y
CONFIG_BOOT_RETRY_TIME=1
CONFIG_RETRY_BOOTCMD=y
CONFIG_OF_BOARD_SETUP=y
CONFIG_USE_PREBOOT=y
CONFIG_SAVE_PREV_BL_INITRAMFS_START_ADDR=y
CONFIG_CONSOLE_RECORD=y
CONFIG_CONSOLE_RECORD_OUT_SIZE=0x6000
CONFIG_SYS_CBSIZE=512
# CONFIG_SYS_DEVICE_NULLDEV is not set
# CONFIG_DISPLAY_CPUINFO is not set
CONFIG_DISPLAY_BOARDINFO_LATE=y
CONFIG_LAST_STAGE_INIT=y
# CONFIG_CMD_BDI is not set
# CONFIG_BOOTM_PLAN9 is not set
# CONFIG_BOOTM_RTEMS is not set
# CONFIG_BOOTM_VXWORKS is not set
# CONFIG_CMD_ELF_BOOTVX is not set
# CONFIG_CMD_IMI is not set
# CONFIG_CMD_XIMG is not set
CONFIG_CMD_MEMINFO=y
CONFIG_CMD_MEMINFO_MAP=y
# CONFIG_CMD_LZMADEC is not set
# CONFIG_CMD_UNLZ4 is not set
# CONFIG_CMD_BIND is not set
CONFIG_CMD_CLK=y
CONFIG_CMD_DFU=y
CONFIG_CMD_GPIO=y
CONFIG_CMD_I2C=y
CONFIG_CMD_MMC=y
CONFIG_CMD_USB_MASS_STORAGE=y
CONFIG_CMD_UMS_ABORT_KEYED=y
CONFIG_CMD_WDT=y
CONFIG_CMD_CAT=y
# CONFIG_CMD_ITEST is not set
# CONFIG_CMD_SETEXPR is not set
CONFIG_CMD_PAUSE=y
CONFIG_CMD_RNG=y
CONFIG_CMD_REGULATOR=y
# CONFIG_ISO_PARTITION is not set
CONFIG_OF_LIVE=y
CONFIG_OF_UPSTREAM_BUILD_VENDOR=y
CONFIG_ENV_USE_DEFAULT_ENV_TEXT_FILE=y
CONFIG_ENV_DEFAULT_ENV_TEXT_FILE="board/qualcomm/qcom-phone.env"
# CONFIG_NET is not set
CONFIG_BLKMAP=y
CONFIG_BUTTON_REMAP_PHONE_KEYS=y
CONFIG_BUTTON_QCOM_PMIC=y
CONFIG_CLK=y
CONFIG_CLK_STUB=y
CONFIG_CLK_QCOM_SDM845=y
CONFIG_CLK_QCOM_SM7150=y
CONFIG_DFU_MMC=y
CONFIG_SYS_DFU_DATA_BUF_SIZE=0x200000
CONFIG_USB_FUNCTION_FASTBOOT=y
CONFIG_FASTBOOT_BUF_ADDR=0x1A000000
CONFIG_FASTBOOT_FLASH=y
CONFIG_FASTBOOT_FLASH_MMC_DEV=0
CONFIG_FASTBOOT_MMC_USER_SUPPORT=y
CONFIG_FASTBOOT_OEM_RUN=y
CONFIG_FASTBOOT_CMD_OEM_CONSOLE=y
CONFIG_MSM_GPIO=y
CONFIG_QCOM_PMIC_GPIO=y
CONFIG_DM_I2C=y
CONFIG_SYS_I2C_QUP=y
CONFIG_SYS_I2C_GENI=y
CONFIG_I2C_MUX=y
CONFIG_DM_KEYBOARD=y
CONFIG_BUTTON_KEYBOARD=y
CONFIG_INTERCONNECT=y
CONFIG_INTERCONNECT_QCOM_RPMH=y
CONFIG_IOMMU=y
CONFIG_QCOM_HYP_SMMU=y
CONFIG_MISC=y
CONFIG_NVMEM=y
CONFIG_QCOM_GENI=y
CONFIG_I2C_EEPROM=y
CONFIG_MMC_SDHCI=y
CONFIG_MMC_SDHCI_ADMA=y
CONFIG_MMC_SDHCI_MSM=y
CONFIG_DM_ETH_PHY=y
CONFIG_PHY=y
CONFIG_PHY_QCOM_QMP_UFS=y
CONFIG_PHY_QCOM_QUSB2=y
CONFIG_PHY_QCOM_USB_SNPS_FEMTO_V2=y
CONFIG_PHY_QCOM_SNPS_EUSB2=y
CONFIG_PINCTRL=y
CONFIG_PINCONF=y
CONFIG_PINCTRL_QCOM_GENERIC=y
# CONFIG_PINCTRL_QCOM_APQ8016 is not set
# CONFIG_PINCTRL_QCOM_APQ8096 is not set
# CONFIG_PINCTRL_QCOM_IPQ4019 is not set
# CONFIG_PINCTRL_QCOM_IPQ5424 is not set
# CONFIG_PINCTRL_QCOM_IPQ9574 is not set
# CONFIG_PINCTRL_QCOM_MILOS is not set
# CONFIG_PINCTRL_QCOM_QCM2290 is not set
# CONFIG_PINCTRL_QCOM_QCS404 is not set
# CONFIG_PINCTRL_QCOM_QCS615 is not set
# CONFIG_PINCTRL_QCOM_SA8775P is not set
# CONFIG_PINCTRL_QCOM_SC7280 is not set
# CONFIG_PINCTRL_QCOM_SDM660 is not set
# CONFIG_PINCTRL_QCOM_SDM845 is not set
# CONFIG_PINCTRL_QCOM_SM6115 is not set
# CONFIG_PINCTRL_QCOM_SM6350 is not set
# CONFIG_PINCTRL_QCOM_SM8150 is not set
# CONFIG_PINCTRL_QCOM_SM8250 is not set
# CONFIG_PINCTRL_QCOM_SM8550 is not set
# CONFIG_PINCTRL_QCOM_SM8650 is not set
# CONFIG_PINCTRL_QCOM_X1E80100 is not set
CONFIG_QCOM_RPMH_POWER_DOMAIN=y
CONFIG_DM_PMIC=y
CONFIG_PMIC_QCOM=y
CONFIG_DM_REGULATOR=y
CONFIG_DM_REGULATOR_FIXED=y
CONFIG_DM_REGULATOR_QCOM_RPMH=y
CONFIG_DM_RNG=y
CONFIG_RNG_MSM=y
# CONFIG_REQUIRE_SERIAL_CONSOLE is not set
CONFIG_MSM_SERIAL=y
CONFIG_MSM_GENI_SERIAL=y
CONFIG_SOC_QCOM=y
CONFIG_QCOM_COMMAND_DB=y
CONFIG_QCOM_RPMH=y
CONFIG_SPMI_MSM=y
CONFIG_SYSRESET_QCOM_PSHOLD=y
CONFIG_USB=y
CONFIG_USB_DWC3=y
CONFIG_USB_DWC3_GENERIC=y
CONFIG_USB_GADGET=y
CONFIG_USB_FUNCTION_ACM=y
CONFIG_VIDEO=y
CONFIG_VIDEO_FONT_16X32=y
CONFIG_SYS_WHITE_ON_BLACK=y
CONFIG_NO_FB_CLEAR=y
CONFIG_VIDEO_SIMPLE=y
CONFIG_WDT=y
CONFIG_WDT_QCOM=y
CONFIG_FAT_WRITE=y
CONFIG_FAT_RENAME=y
CONFIG_FS_FAT_HANDLE_SECTOR_SIZE_MISMATCH=y
CONFIG_PANIC_HANG=y
CONFIG_REGEX=y
CONFIG_GETOPT=y
# CONFIG_TOOLS_KWBIMAGE is not set
```
